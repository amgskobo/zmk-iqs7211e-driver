## Kconfig
```kconfig
# Copyright (c) 2025 amgskobo
# SPDX-License-Identifier: MIT

menuconfig IQS7211E
  bool "IQS7211E Trackpad"
  select ZMK_POINTING
  select I2C
  select GPIO
  help
    Enable driver for IQS7211E.

if IQS7211E

config IQS7211E_FILTER_BYPASS
  bool "Bypass host coordinate filtering for diagnostic comparisons"
  default n
  help
    Pass valid normalized coordinates without the host deadband or three-point
    median, and report relative deltas without the two-delta average. Sensor
    register filtering, validity checks, rotation, contact lifecycle and gesture
    handling remain unchanged. This applies to both report modes and every
    IQS7211E device; leave disabled for the existing production behavior.

config IQS7211E_WORKQUEUE_STACK_SIZE
  int "IQS7211E work queue stack size"
  default 1536
  range 1024 4096
  help
    Stack size in bytes for the driver-owned work queue. The queue serializes
    sensor reads, input reports, generated clicks, touch verification, and
    suspend-time releases.

config IQS7211E_WORKQUEUE_PRIORITY
  int "IQS7211E work queue priority"
  default -1 if NUM_COOP_PRIORITIES > 0
  default 0
  range -16 15
  help
    Priority used by the driver-owned work queue. The default is cooperative
    -1, or preemptive 0 when cooperative priorities are unavailable. The selected
    priority must fit the kernel's configured priority counts. This keeps RDY
    servicing prompt. If the input message queue fills, blocking
    input reports let the input thread run and drain it without dropping an
    event.

config IQS7211E_PM_EARLY_INIT_PRIORITY
  int "Init priority of the early suspend device"
  default 45
  depends on PM_DEVICE
  help
    POST_KERNEL priority of a small device that suspends every IQS7211E
    while its I2C bus still works when ZMK powers off through &soft_off.
    That path suspends devices in init order, and the sensor's own device
    comes after the bus, where it cannot reach the sensor any more: without
    this the sensor stays awake, at its active current, for as long as the
    keyboard is off. Must be below I2C_INIT_PRIORITY.

endif

config ZMK_IQS7211E_DRIVER_LOG_LEVEL
    int "zmk-iqs7211e-driver log level (0 off, 1 error, 2 warning, 3 info, 4 debug)"
    range 0 4
    default 3
    help
      Logs contain operational state and numeric diagnostics, never input
      contents, user labels, peer addresses or authentication material.
```

## dts/bindings/input/azoteq,iqs7211e.yml
```yaml
description: Azoteq IQS7211E trackpad zmk driver

compatible: "azoteq,iqs7211e"

include: i2c-device.yaml

properties:
  reg:
    required: true
    description: I2C address of the device
  irq-gpios:
    type: phandle-array
    required: true
    description: Interrupt pin
  single-tap:
    type: int
    default: -1
    description: |
      Set the button triggered by a single-tap.
      -1 = disabled, 0 = BTN_0, 1 = BTN_1, 2 = BTN_2
  double-tap:
    type: int
    default: -1
    description: |
      Set the button triggered by double-tap.
      -1 = disabled, 0 = BTN_0, 1 = BTN_1, 2 = BTN_2
  triple-tap:
    type: int
    default: -1
    description: |
      Set the button triggered by triple-tap.
      -1 = disabled, 0 = BTN_0, 1 = BTN_1, 2 = BTN_2
  rotate-cw:
    type: int
    default: 0
    enum:
      - 0
      - 1
      - 2
      - 3
    description: |
      Clockwise rotation applied to every reported coordinate, to match how the
      module is physically mounted.
      0 = 0 deg, 1 = 90 deg, 2 = 180 deg, 3 = 270 deg
  report-abs:
    type: boolean
    description: |
      If true, report absolute coordinates instead of relative ones. If omitted,
      the driver reports relative coordinates directly.
  jitter-deadband:
    type: int
    default: 8
    description: |
      Maximum per-axis coordinate distance held by the rubber-band jitter gate
      before motion is reported. This is applied independently to X and Y, not
      as a Euclidean radius. The three-sample median filter remains active when
      this is 0. The default of 8 is a conservative starting point for the
      Trackpad01 panel; override it from the board overlay when measurements
      show a different stationary-jitter/fine-motion boundary. The normalized
      coordinate range is 0-1024 inclusive.
  touch-verify-interval-ms:
    type: int
    default: 120
    description: |
      While a touch remains active, run a full report read at this interval to
      verify that the physical touch is still present. This applies equally to
      absolute and relative reporting so both modes observe the same touch
      samples and release timing. If the read fails or no fingers are present, report touch
      release and stop verification. Set to 0 to disable host verification
      and retain the sensor's 60-second Idle-Touch fallback.
```
