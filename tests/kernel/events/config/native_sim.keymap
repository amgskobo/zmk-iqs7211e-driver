/* Copyright (c) 2026 amgskobo
 * SPDX-License-Identifier: MIT
 */
#include <behaviors.dtsi>
#include <dt-bindings/zmk/keys.h>
&kscan { events = <>; /delete-property/ exit-after; };
/ {
    keymap {
        compatible = "zmk,keymap";
        default_layer { bindings = <&kp A &kp B &kp C &kp D>; };
    };
};
